#include "control.h"

VTM_Data_t key;

static uint16_t crc16_init = 0xffff;
static const uint16_t crc16_tab[256] =
{
    0x0000, 0x1189, 0x2312, 0x329b, 0x4624, 0x57ad, 0x6536, 0x74bf,
    0x8c48, 0x9dc1, 0xaf5a, 0xbed3, 0xca6c, 0xdbe5, 0xe97e, 0xf8f7,
    0x1081, 0x0108, 0x3393, 0x221a, 0x56a5, 0x472c, 0x75b7, 0x643e,
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	0x7bc7, 0x6a4e, 0x58d5, 0x495c, 0x3de3, 0x2c6a, 0x1ef1, 0x0f78
};
uint8_t VTM_Rx_Buf[RX_BUF_SIZE];

static bool verify_crc16_check_sum(uint8_t *p_msg, uint16_t len);
static uint16_t get_crc16_check_sum(uint8_t *p_msg, uint16_t len, uint16_t crc16);

void VTM_UART_Init(void) {
    // 1. 开启 DMA 循环接收
    HAL_UART_Receive_DMA(&huart1, VTM_Rx_Buf, RX_BUF_SIZE);
    
    // 2. 开启空闲中断
    __HAL_UART_ENABLE_IT(&huart1, UART_IT_IDLE);
}

void VTM_Data_Parsing(uint8_t *p_frame) {
    // 1. 基础校验：帧头校验与CRC校验
    if (p_frame[0] != 0xA9 || p_frame[1] != 0x53) return;
    if (!verify_crc16_check_sum(p_frame, 21)) return;

    // 2. 摇杆与通道解析 (非字节对齐位移)
    key.ch0 = ((p_frame[2] >> 0) | (p_frame[3] << 8)) & 0x07FF;
    key.ch1 = ((p_frame[3] >> 3) | (p_frame[4] << 5)) & 0x07FF;
    key.ch2 = ((p_frame[4] >> 6) | (p_frame[5] << 2) | (p_frame[6] << 10)) & 0x07FF;
    key.ch3 = ((p_frame[6] >> 1) | (p_frame[7] << 7)) & 0x07FF;
    
    key.sw     = (p_frame[7] >> 4) & 0x03;
    key.pause  = (p_frame[7] >> 6) & 0x01;
    key.btn_l  = (p_frame[7] >> 7) & 0x01;
    key.btn_r  = (p_frame[8] >> 0) & 0x01;
    key.dial   = ((p_frame[8] >> 1) | (p_frame[9] << 7)) & 0x07FF;
    key.trigger = (p_frame[9] >> 4) & 0x01;

    // 3. 鼠标解析 (16位有符号)
    key.mouse_x = (int16_t)(p_frame[10] | (p_frame[11] << 8));
    key.mouse_y = (int16_t)(p_frame[12] | (p_frame[13] << 8));
    key.mouse_z = (int16_t)(p_frame[14] | (p_frame[15] << 8));
    
    key.mouse_btn_l = p_frame[16] & 0x03;
    key.mouse_btn_r = (p_frame[16] >> 2) & 0x03;
    key.mouse_btn_m = (p_frame[16] >> 4) & 0x03;

    // 4. 键盘所有按键读取 (提取位图中的每一位)
    uint16_t key_v = (uint16_t)(p_frame[17] | (p_frame[18] << 8));
    
    key.key_w     = (key_v & KEY_W_BIT)     ? 1 : 0;
    key.key_s     = (key_v & KEY_S_BIT)     ? 1 : 0;
    key.key_a     = (key_v & KEY_A_BIT)     ? 1 : 0;
    key.key_d     = (key_v & KEY_D_BIT)     ? 1 : 0;
    key.key_shift = (key_v & KEY_SHIFT_BIT) ? 1 : 0;
    key.key_ctrl  = (key_v & KEY_CTRL_BIT)  ? 1 : 0;
    key.key_q     = (key_v & KEY_Q_BIT)     ? 1 : 0;
    key.key_e     = (key_v & KEY_E_BIT)     ? 1 : 0;
    key.key_r     = (key_v & KEY_R_BIT)     ? 1 : 0;
    key.key_f     = (key_v & KEY_F_BIT)     ? 1 : 0;
    key.key_g     = (key_v & KEY_G_BIT)     ? 1 : 0;
    key.key_z     = (key_v & KEY_Z_BIT)     ? 1 : 0;
    key.key_x     = (key_v & KEY_X_BIT)     ? 1 : 0;
    key.key_c     = (key_v & KEY_C_BIT)     ? 1 : 0;
    key.key_v     = (key_v & KEY_V_BIT)     ? 1 : 0;
    key.key_b     = (key_v & KEY_B_BIT)     ? 1 : 0;
}

static uint16_t get_crc16_check_sum(uint8_t *p_msg, uint16_t len, uint16_t crc16)
{
    uint8_t data;

    if(p_msg == NULL)
    {
        return 0xffff;
    }

    while(len--)
    {
        data = *p_msg++;
        (crc16) = ((uint16_t)(crc16) >> 8) ^ crc16_tab[((uint16_t)(crc16) ^ (uint16_t)(data)) & 0x00ff];
    }

    return crc16;
}

static bool verify_crc16_check_sum(uint8_t *p_msg, uint16_t len)
{
    uint16_t w_expected = 0;

    if((p_msg == NULL) || (len <= 2))
    {
        return false;
    }
    w_expected = get_crc16_check_sum(p_msg, len - 2, crc16_init);

    return ((w_expected & 0xff) == p_msg[len - 2] && ((w_expected >> 8) & 0xff) == p_msg[len - 1]);
}
